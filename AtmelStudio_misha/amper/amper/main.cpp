/* PD3-PD0 && PC5-PC2 шина_данных_на_дисплей
PC1 вход_АЦП
PB1 && PC0 транзисторы_

PC2   B
PC3   C
PC4   E
PC5   D
PD0   G
PD1   Dp
PD2   A
PD3   F
*/
#define F_CPU 1000000
#define k 1
#include <avr/io.h>
uint8_t r1 = 0;
uint8_t r2 = 0;
uint8_t dp = 0;
uint8_t a = 0;
int b = 0;
int q = 0;
int main(void)
{
	DDRC |= (1<<5) | (1<<4) | (1<<3) | (1<<2) | (0<<1) | (1<<0);
	DDRD |= (1<<3) | (1<<2) | (1<<1) | (1<<0);
	DDRB |= (1<<1);
	TCCR0 = 0b00000101;
	TCNT0 = 0;
	ADCSRA = 0b11100011;
	ADMUX = 0b11000001;

	
	while (1)
	{
		//b = (ADC*0.0025 - 0.072)*12.195121*10*k;

//		if (ADCSRA & (1<<ADIF)) {
        q = (ADC*0.0025 - 0.072)*12.195121*10*k;
//		}
        if (TCNT0 == 50) {
			b = q;
			TCNT0 = 0;
		}
		
		if (b <= 0) b = 0;

		if (b >= 100) {
			r1 = b*0.01;
			r2 = b/10%10;
			dp = 0;
		}
		else {
			r1 = b*0.1;
			r2 = b%10;
			dp = 1;
		}
		
		PORTC &= (0<<0);
		PORTB |= (1<<1);
		a = TCNT0;
		while (TCNT0 == a) {
			switch (r1) {
				case 0: PORTD |= (1<<2) | (1<<3); PORTC |= (1<<2) | (1<<3) | (1<<4) | (1<<5); break;
				case 1: PORTC |= (1<<2) | (1<<3); break;
				case 2: PORTD |= (1<<0) | (1<<2); PORTC |= (1<<2) | (1<<4) | (1<<5); break;
				case 3: PORTD |= (1<<0) | (1<<2); PORTC |= (1<<2) | (1<<3) | (1<<5); break;
				case 4: PORTD |= (1<<0) | (1<<3); PORTC |= (1<<2) | (1<<3); break;
				case 5: PORTD |= (1<<0) | (1<<2) | (1<<3); PORTC |= (1<<3) | (1<<5); break;
				case 6: PORTD |= (1<<0) | (1<<2) | (1<<3); PORTC |= (1<<3) | (1<<4) | (1<<5); break;
				case 7: PORTD |= (1<<2); PORTC |= (1<<2) | (1<<3); break;
				case 8: PORTD |= (1<<0) | (1<<2) | (1<<3); PORTC |= (1<<2) | (1<<3) | (1<<4) | (1<<5); break;
				case 9: PORTD |= (1<<0) | (1<<2) | (1<<3); PORTC |= (1<<2) | (1<<3) | (1<<5); break;
			}
			if (dp == 1) PORTD |= (1<<1); else PORTD &= ~(1<<1);
		}
		
		PORTB &= (0<<1);
		PORTD &= ~(1<<2) & ~(1<<3); PORTC &= ~(1<<2) & ~(1<<3) & ~(1<<4) & ~(1<<5);
		PORTC &= ~(1<<2) & ~(1<<3);
		PORTD &= ~(1<<0) & ~(1<<2); PORTC &= ~(1<<2) & ~(1<<4) & ~(1<<5);
		PORTD &= ~(1<<0) & ~(1<<2); PORTC &= ~(1<<2) & ~(1<<3) & ~(1<<5);
		PORTD &= ~(1<<0) & ~(1<<3); PORTC &= ~(1<<2) & ~(1<<3);
		PORTD &= ~(1<<0) & ~(1<<2) & ~(1<<3); PORTC &= ~(1<<3) & ~(1<<5);
		PORTD &= ~(1<<0) & ~(1<<2) & ~(1<<3); PORTC &= ~(1<<3) & ~(1<<4) & ~(1<<5);
		PORTD &= ~(1<<2); PORTC &= ~(1<<2) & ~(1<<3);
		PORTD &= ~(1<<0) & ~(1<<2) & ~(1<<3); PORTC &= ~(1<<2) & ~(1<<3) & ~(1<<4) & ~(1<<5);
		PORTD &= ~(1<<0) & ~(1<<2) & ~(1<<3); PORTC &= ~(1<<2) & ~(1<<3) & ~(1<<5);
		PORTD &= ~(1<<1);
		PORTC |= (1<<0);
		
		a = TCNT0;
		
		while (TCNT0 == a) {
			switch (r2) {
				case 0: PORTD |= (1<<2) | (1<<3); PORTC |= (1<<2) | (1<<3) | (1<<4) | (1<<5); break;
				case 1: PORTC |= (1<<2) | (1<<3); break;
				case 2: PORTD |= (1<<0) | (1<<2); PORTC |= (1<<2) | (1<<4) | (1<<5); break;
				case 3: PORTD |= (1<<0) | (1<<2); PORTC |= (1<<2) | (1<<3) | (1<<5); break;
				case 4: PORTD |= (1<<0) | (1<<3); PORTC |= (1<<2) | (1<<3); break;
				case 5: PORTD |= (1<<0) | (1<<2) | (1<<3); PORTC |= (1<<3) | (1<<5); break;
				case 6: PORTD |= (1<<0) | (1<<2) | (1<<3); PORTC |= (1<<3) | (1<<4) | (1<<5); break;
				case 7: PORTD |= (1<<2); PORTC |= (1<<2) | (1<<3); break;
				case 8: PORTD |= (1<<0) | (1<<2) | (1<<3); PORTC |= (1<<2) | (1<<3) | (1<<4) | (1<<5); break;
				case 9: PORTD |= (1<<0) | (1<<2) | (1<<3); PORTC |= (1<<2) | (1<<3) | (1<<5); break;
			}
		}

		PORTD &= ~(1<<2) & ~(1<<3); PORTC &= ~(1<<2) & ~(1<<3) & ~(1<<4) & ~(1<<5);
		PORTC &= ~(1<<2) & ~(1<<3);
		PORTD &= ~(1<<0) & ~(1<<2); PORTC &= ~(1<<2) & ~(1<<4) & ~(1<<5);
		PORTD &= ~(1<<0) & ~(1<<2); PORTC &= ~(1<<2) & ~(1<<3) & ~(1<<5);
		PORTD &= ~(1<<0) & ~(1<<3); PORTC &= ~(1<<2) & ~(1<<3);
		PORTD &= ~(1<<0) & ~(1<<2) & ~(1<<3); PORTC &= ~(1<<3) & ~(1<<5);
		PORTD &= ~(1<<0) & ~(1<<2) & ~(1<<3); PORTC &= ~(1<<3) & ~(1<<4) & ~(1<<5);
		PORTD &= ~(1<<2); PORTC &= ~(1<<2) & ~(1<<3);
		PORTD &= ~(1<<0) & ~(1<<2) & ~(1<<3); PORTC &= ~(1<<2) & ~(1<<3) & ~(1<<4) & ~(1<<5);
		PORTD &= ~(1<<0) & ~(1<<2) & ~(1<<3); PORTC &= ~(1<<2) & ~(1<<3) & ~(1<<5);

	}
}




